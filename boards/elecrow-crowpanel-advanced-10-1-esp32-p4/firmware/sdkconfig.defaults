## boards/elecrow-crowpanel-advanced-10-1-esp32-p4/firmware/sdkconfig.defaults
```kconfig
# ESP32-P4NRW32 (16 MB flash, 32 MB hex-mode PSRAM) on the CrowPanel
# Advanced 10.1". Flash/PSRAM/cache values follow Elecrow's factory config.
CONFIG_IDF_TARGET="esp32p4"
# 200 MHz PSRAM on the P4 is gated behind this flag in IDF 5.4.
CONFIG_IDF_EXPERIMENTAL_FEATURES=y
CONFIG_ESPTOOLPY_FLASHMODE_QIO=y
CONFIG_ESPTOOLPY_FLASHFREQ_80M=y
CONFIG_ESPTOOLPY_FLASHSIZE_16MB=y
CONFIG_PARTITION_TABLE_CUSTOM=y
CONFIG_PARTITION_TABLE_CUSTOM_FILENAME="partitions.csv"
CONFIG_COMPILER_OPTIMIZATION_PERF=y
CONFIG_ESP_DEFAULT_CPU_FREQ_MHZ_360=y
CONFIG_APP_REPRODUCIBLE_BUILD=y

# UART0 carries the Stream32 JSON protocol through the CH340 bridge, so no
# console may share it. Only the ROM's boot banner appears on reset; the
# desktop tolerates that pre-handshake noise.
CONFIG_ESP_CONSOLE_NONE=y

CONFIG_SPIRAM=y
CONFIG_SPIRAM_MODE_HEX=y
CONFIG_SPIRAM_SPEED_200M=y
CONFIG_SPIRAM_USE_MALLOC=y
CONFIG_CACHE_L2_CACHE_128KB=y
CONFIG_CACHE_L2_CACHE_LINE_64B=y

# Stream32 deck grid: free-form shapes up to 10 per axis (9x4, 4x9, ...)
# within a 40-key page budget. Budgets above 30 keys use two flash sectors
# per stored page and need the 8 KB protocol line buffer in main.c.
CONFIG_STREAM32_DECK_SCREEN_WIDTH=1024
CONFIG_STREAM32_DECK_SCREEN_HEIGHT=600
CONFIG_STREAM32_DECK_MAX_ROWS=10
CONFIG_STREAM32_DECK_MAX_COLS=10
CONFIG_STREAM32_DECK_MAX_KEYS=40

CONFIG_FREERTOS_HZ=1000
# The default light theme renders card/label text near-black on the dark UI.
CONFIG_LV_THEME_DEFAULT_DARK=y
CONFIG_LV_USE_CLIB_MALLOC=y
CONFIG_LV_USE_CLIB_STRING=y
CONFIG_LV_USE_CLIB_SPRINTF=y
CONFIG_LV_DEF_REFR_PERIOD=15
CONFIG_LV_OS_FREERTOS=y
CONFIG_LV_DRAW_SW_DRAW_UNIT_CNT=2
CONFIG_LV_FONT_MONTSERRAT_14=y
CONFIG_LV_FONT_MONTSERRAT_20=y
CONFIG_LV_FONT_MONTSERRAT_28=y
CONFIG_LV_USE_FONT_COMPRESSED=y
```

## boards/waveshare-esp32-s3-touch-lcd-4-v3/firmware/sdkconfig.defaults
```kconfig
# ESP32-S3 N16R8 and Waveshare Rev3 display settings.
CONFIG_IDF_TARGET="esp32s3"
CONFIG_ESPTOOLPY_FLASHMODE_QIO=y
CONFIG_ESPTOOLPY_FLASHFREQ_80M=y
CONFIG_ESPTOOLPY_FLASHSIZE_16MB=y
CONFIG_PARTITION_TABLE_CUSTOM=y
CONFIG_PARTITION_TABLE_CUSTOM_FILENAME="partitions.csv"
CONFIG_COMPILER_OPTIMIZATION_PERF=y
CONFIG_ESP_DEFAULT_CPU_FREQ_MHZ_240=y
CONFIG_APP_REPRODUCIBLE_BUILD=y
CONFIG_ESP_CONSOLE_UART_DEFAULT=y
CONFIG_ESP_CONSOLE_SECONDARY_NONE=y

CONFIG_SPIRAM=y
CONFIG_SPIRAM_MODE_OCT=y
CONFIG_SPIRAM_SPEED_80M=y
CONFIG_SPIRAM_FETCH_INSTRUCTIONS=y
CONFIG_SPIRAM_RODATA=y
CONFIG_ESP32S3_DATA_CACHE_LINE_64B=y

# The GT911 on this board was unstable at the BSP's 400 kHz default.
# CONFIG_BSP_I2C_FAST_MODE is not set
# Return display/touch initialization errors instead of rebooting on assert.
# CONFIG_BSP_ERROR_CHECK is not set

# Stream32 deck grid: this square 480x480 panel maxes out at 5x5, which
# keeps its layout lines and page storage on the baseline 4 KB format.
CONFIG_STREAM32_DECK_SCREEN_WIDTH=480
CONFIG_STREAM32_DECK_SCREEN_HEIGHT=480
CONFIG_STREAM32_DECK_MAX_ROWS=5
CONFIG_STREAM32_DECK_MAX_COLS=5
CONFIG_STREAM32_DECK_MAX_KEYS=25

CONFIG_FREERTOS_HZ=1000
# The default light theme renders card/label text near-black on the dark UI.
CONFIG_LV_THEME_DEFAULT_DARK=y
CONFIG_LV_USE_CLIB_MALLOC=y
CONFIG_LV_USE_CLIB_STRING=y
CONFIG_LV_USE_CLIB_SPRINTF=y
CONFIG_LV_DEF_REFR_PERIOD=15
CONFIG_LV_OS_FREERTOS=y
CONFIG_LV_DRAW_SW_DRAW_UNIT_CNT=2
CONFIG_LV_ATTRIBUTE_FAST_MEM_USE_IRAM=y
CONFIG_LV_FONT_MONTSERRAT_14=y
CONFIG_LV_FONT_MONTSERRAT_20=y
CONFIG_LV_FONT_MONTSERRAT_28=y
CONFIG_LV_USE_FONT_COMPRESSED=y
```
